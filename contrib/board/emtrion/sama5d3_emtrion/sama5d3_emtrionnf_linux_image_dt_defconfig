## contrib/board/emtrion/sama5d3_emtrion/sama5d3_emtrionnf_linux_image_dt_defconfig
```kconfig
HAVE_DOT_CONFIG=y
CONFIG_SAMA5D3_EMTRION=y
CONFIG_BOARDNAME="sama5d3_emtrion"
SAMA5D3X=y
CONFIG_MACH_TYPE="9999"
# CONFIG_OVERRIDE_MACH_TYPE is not set
CONFIG_LINK_ADDR="0x300000"
CONFIG_TOP_OF_MEMORY="0x310000"
CONFIG_CRYSTAL_12_000MHZ=y
ALLOW_CRYSTAL_12_000MHZ=y
CONFIG_CRYSTAL="CRYSTAL_12_000MHZ"
CONFIG_CPU_CLK_528MHZ=y
ALLOW_CPU_CLK_528MHZ=y
CONFIG_BUS_SPEED_133MHZ=y
SUPPORT_BUS_SPEED_133MHZ=y
# CPU_HAS_TRUSTZONE is not set
# CONFIG_CPU_V7 is not set
CONFIG_SUPPORT_PM=y
# CONFIG_HAS_ONE_WIRE is not set
# CONFIG_HAS_EEPROM is not set
CONFIG_HAS_EHT0_PHY=y
CONFIG_HAS_EHT1_PHY=y
# CONFIG_HAS_AUDIO_CODEC is not set
# CONFIG_HAS_HDMI is not set
# CORE_ARM926EJS is not set
CORE_CORTEX_A5=y
CPU_HAS_SCKC=y
# CPU_HAS_H32MXDIV is not set
CPU_HAS_HSMCI0=y
CPU_HAS_HSMCI1=y
CPU_HAS_HSMCI2=y
# CPU_HAS_MCI0 is not set
# CPU_HAS_MCI1 is not set
# CPU_HAS_SDHC0 is not set
# CPU_HAS_SDHC1 is not set
CPU_HAS_SPI0=y
CPU_HAS_SPI1=y
# BOARD_HAS_2_BANKS is not set
CPU_HAS_PIO3=y
# CPU_HAS_L2CC is not set
CPU_HAS_PMECC=y
# CONFIG_HAS_HW_INFO is not set
CONFIG_MACB=y
# CONFIG_AES is not set
# CONFIG_LOAD_HW_INFO is not set
CPU_HAS_AES=y
# CPU_HAS_PIO4 is not set

#
# Memory selection
#
# CONFIG_SDRAM is not set
# CONFIG_SDDRC is not set
CONFIG_DDRC=y
# ALLOW_DATAFLASH is not set
# ALLOW_FLASH is not set
ALLOW_NANDFLASH=y
ALLOW_SDCARD=y
# ALLOW_PSRAM is not set
# ALLOW_SDRAM_16BIT is not set

#
# RAM Configuration
#
# CONFIG_RAM_32MB is not set
# CONFIG_RAM_64MB is not set
# CONFIG_RAM_128MB is not set
# CONFIG_RAM_256MB is not set
CONFIG_RAM_512MB=y
# CONFIG_LPDDR1 is not set
# CONFIG_LPDDR2 is not set
# CONFIG_LPDDR3 is not set
CONFIG_DDR2=y
# CONFIG_DDR3 is not set
# CONFIG_SAMA5D2_LPDDR2 is not set
# CONFIG_DATAFLASH is not set
# CONFIG_FLASH is not set
CONFIG_NANDFLASH=y
# CONFIG_SDCARD is not set
CONFIG_MEMORY="nandflash"

#
# NAND flash configuration
#
# CONFIG_ENABLE_SW_ECC is not set
CONFIG_USE_PMECC=y
# CONFIG_ON_DIE_ECC is not set

#
# PMECC Configuration
#
# CONFIG_PMECC_AUTO_DETECT is not set
# CONFIG_PMECC_CORRECT_BITS_2 is not set
CONFIG_PMECC_CORRECT_BITS_4=y
# CONFIG_PMECC_CORRECT_BITS_8 is not set
# CONFIG_PMECC_CORRECT_BITS_12 is not set
# CONFIG_PMECC_CORRECT_BITS_24 is not set
CONFIG_PMECC_SECTOR_SIZE_512=y
# CONFIG_PMECC_SECTOR_SIZE_1024 is not set
# CONFIG_NANDFLASH_SMALL_BLOCKS is not set
CONFIG_ONFI_DETECT_SUPPORT=y
CONFIG_USE_ON_DIE_ECC_SUPPORT=y
# ALLOW_NANDFLASH_RECOVERY is not set
CONFIG_BOOTSTRAP_MAXSIZE="65536"
CONFIG_PROJECT="nandflash"
# CONFIG_LOAD_UBOOT is not set
CONFIG_LOAD_LINUX=y
# CONFIG_LOAD_NONE is not set
# CONFIG_LOAD_ANDROID is not set
# CONFIG_LOAD_1MB is not set
# CONFIG_LOAD_4MB is not set
# CONFIG_LOAD_64KB is not set
CONFIG_LINUX_IMAGE=y

#
# Kernel Image Storage Setup
#
CONFIG_OVERRIDE_CMDLINE=y
CONFIG_LINUX_KERNEL_ARG_STRING="console=ttyS0,115200 earlyprintk mtdparts=atmel_nand:256k(uboot_spl)ro,768k(uboot)ro,512k(uboot_env),512k(device_tree),6M(kernel)ro,-(rootfs) rootfstype=ubifs ubi.mtd=5 root=ubi0:rootfs"
CONFIG_MEM_BANK="0x20000000"
CONFIG_MEM_SIZE="0x10000000"
CONFIG_IMG_ADDRESS="0x00200000"
CONFIG_JUMP_ADDR="0x22000000"

#
# Flattened Device Tree
#
CONFIG_OF_LIBFDT=y
CONFIG_OF_OFFSET="0x00180000"
CONFIG_OF_ADDRESS="0x21000000"
CONFIG_DEBUG=y
CONFIG_DEBUG_INFO=y
# CONFIG_DEBUG_LOUD is not set
# CONFIG_DEBUG_VERY_LOUD is not set
# CONFIG_SECURE is not set
CONFIG_DISABLE_WATCHDOG=y

#
# Hardware Initialization Options
#
CONFIG_HW_DISPLAY_BANNER=y
CONFIG_HW_BANNER="\"\\n\\nAT91Bootstrap \" AT91BOOTSTRAP_VERSION \" (\" COMPILE_TIME \")\\n\\n\""
CONFIG_HW_INIT=y
# CONFIG_USER_HW_INIT is not set

#
# Slow Clock Configuration Options
#
CONFIG_SCLK=y
# CONFIG_SCLK_BYPASS is not set
CONFIG_PM=y

#
# Select the Devices to the Low-power mode
#
CONFIG_MAC0_PHY=y
CONFIG_MAC1_PHY=y
# CONFIG_PM_PMIC is not set
# CONFIG_BACKUP_MODE is not set

#
# Board's Workaround Options
#
# CONFIG_ACT8865_SET_VOLTAGE is not set
# CONFIG_DISABLE_ACT8865_I2C is not set
# CONFIG_SUSPEND_ACT8945A_CHARGER is not set
# CONFIG_ACT8865 is not set
```

## contrib/board/emtrion/sama5d3_emtrion/sama5d3_emtrionnf_uboot_defconfig
```kconfig
HAVE_DOT_CONFIG=y
CONFIG_SAMA5D3_EMTRION=y
CONFIG_BOARDNAME="sama5d3_emtrion"
SAMA5D3X=y
CONFIG_MACH_TYPE="9999"
# CONFIG_OVERRIDE_MACH_TYPE is not set
CONFIG_LINK_ADDR="0x300000"
CONFIG_TOP_OF_MEMORY="0x310000"
CONFIG_CRYSTAL_12_000MHZ=y
ALLOW_CRYSTAL_12_000MHZ=y
CONFIG_CRYSTAL="CRYSTAL_12_000MHZ"
CONFIG_CPU_CLK_528MHZ=y
ALLOW_CPU_CLK_528MHZ=y
CONFIG_BUS_SPEED_133MHZ=y
SUPPORT_BUS_SPEED_133MHZ=y
# CPU_HAS_TRUSTZONE is not set
# CONFIG_CPU_V7 is not set
CONFIG_SUPPORT_PM=y
# CONFIG_HAS_ONE_WIRE is not set
# CONFIG_HAS_EEPROM is not set
CONFIG_HAS_EHT0_PHY=y
CONFIG_HAS_EHT1_PHY=y
# CONFIG_HAS_AUDIO_CODEC is not set
# CONFIG_HAS_HDMI is not set
# CORE_ARM926EJS is not set
CORE_CORTEX_A5=y
CPU_HAS_SCKC=y
# CPU_HAS_H32MXDIV is not set
CPU_HAS_HSMCI0=y
CPU_HAS_HSMCI1=y
CPU_HAS_HSMCI2=y
# CPU_HAS_MCI0 is not set
# CPU_HAS_MCI1 is not set
# CPU_HAS_SDHC0 is not set
# CPU_HAS_SDHC1 is not set
CPU_HAS_SPI0=y
CPU_HAS_SPI1=y
# BOARD_HAS_2_BANKS is not set
CPU_HAS_PIO3=y
# CPU_HAS_L2CC is not set
CPU_HAS_PMECC=y
# CONFIG_HAS_HW_INFO is not set
CONFIG_MACB=y
# CONFIG_AES is not set
# CONFIG_LOAD_HW_INFO is not set
CPU_HAS_AES=y
# CPU_HAS_PIO4 is not set

#
# Memory selection
#
# CONFIG_SDRAM is not set
# CONFIG_SDDRC is not set
CONFIG_DDRC=y
# ALLOW_DATAFLASH is not set
# ALLOW_FLASH is not set
ALLOW_NANDFLASH=y
ALLOW_SDCARD=y
# ALLOW_PSRAM is not set
# ALLOW_SDRAM_16BIT is not set

#
# RAM Configuration
#
CONFIG_RAM_512MB=y
# CONFIG_LPDDR1 is not set
# CONFIG_LPDDR2 is not set
# CONFIG_LPDDR3 is not set
CONFIG_DDR2=y
# CONFIG_DDR3 is not set
# CONFIG_SAMA5D2_LPDDR2 is not set
# CONFIG_DATAFLASH is not set
# CONFIG_FLASH is not set
CONFIG_NANDFLASH=y
# CONFIG_SDCARD is not set
CONFIG_MEMORY="nandflash"

#
# NAND flash configuration
#
# CONFIG_ENABLE_SW_ECC is not set
CONFIG_USE_PMECC=y
# CONFIG_ON_DIE_ECC is not set

#
# PMECC Configuration
#
# CONFIG_PMECC_AUTO_DETECT is not set
# CONFIG_PMECC_CORRECT_BITS_2 is not set
CONFIG_PMECC_CORRECT_BITS_4=y
# CONFIG_PMECC_CORRECT_BITS_8 is not set
# CONFIG_PMECC_CORRECT_BITS_12 is not set
# CONFIG_PMECC_CORRECT_BITS_24 is not set
CONFIG_PMECC_SECTOR_SIZE_512=y
# CONFIG_PMECC_SECTOR_SIZE_1024 is not set
# CONFIG_NANDFLASH_SMALL_BLOCKS is not set
CONFIG_ONFI_DETECT_SUPPORT=y
CONFIG_USE_ON_DIE_ECC_SUPPORT=y
# ALLOW_NANDFLASH_RECOVERY is not set
CONFIG_BOOTSTRAP_MAXSIZE="65536"
CONFIG_PROJECT="nandflash"
CONFIG_LOAD_UBOOT=y
# CONFIG_LOAD_LINUX is not set
# CONFIG_LOAD_NONE is not set
# CONFIG_LOAD_ANDROID is not set
# CONFIG_LOAD_1MB is not set
# CONFIG_LOAD_4MB is not set
# CONFIG_LOAD_64KB is not set
CONFIG_IMG_ADDRESS="0x00040000"
CONFIG_JUMP_ADDR="0x26F00000"

#
# U-Boot Image Storage Setup
#
CONFIG_IMG_SIZE="0x000c0000"
CONFIG_DEBUG=y
CONFIG_DEBUG_INFO=y
CONFIG_DEBUG_LOUD=y
CONFIG_DEBUG_VERY_LOUD=y
# CONFIG_SECURE is not set
CONFIG_DISABLE_WATCHDOG=y

#
# Hardware Initialization Options
#
CONFIG_HW_DISPLAY_BANNER=y
CONFIG_HW_BANNER="\"\\n\\nAT91Bootstrap \" AT91BOOTSTRAP_VERSION \" (\" COMPILE_TIME \")\\n\\n\""
CONFIG_HW_INIT=y
# CONFIG_USER_HW_INIT is not set

#
# Slow Clock Configuration Options
#
CONFIG_SCLK=y
# CONFIG_SCLK_BYPASS is not set
CONFIG_PM=y

#
# Select the Devices to the Low-power mode
#
CONFIG_MAC0_PHY=y
CONFIG_MAC1_PHY=y
# CONFIG_PM_PMIC is not set
# CONFIG_BACKUP_MODE is not set

#
# Board's Workaround Options
#
# CONFIG_ACT8865_SET_VOLTAGE is not set
# CONFIG_DISABLE_ACT8865_I2C is not set
# CONFIG_SUSPEND_ACT8945A_CHARGER is not set
# CONFIG_ACT8865 is not set
```

## contrib/board/emtrion/sama5d3_emtrionnf_linux_image_dt_defconfig
```kconfig
CONFIG_SAMA5D3_EMTRION=y
CONFIG_CPU_CLK_528MHZ=y
CONFIG_RAM_256MB=y
# CONFIG_PMECC_AUTO_DETECT is not set
CONFIG_PMECC_CORRECT_BITS_4=y
CONFIG_LOAD_LINUX=y
CONFIG_OVERRIDE_CMDLINE=y
CONFIG_DEBUG=y
```
